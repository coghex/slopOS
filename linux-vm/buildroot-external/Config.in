## linux-vm/buildroot-external/Config.in
```kconfig
menu "slopOS packages"
	source "$BR2_EXTERNAL_SLOPOS_PATH/package/slopos-seedrng/Config.in"
endmenu
```

## linux-vm/buildroot-external/package/slopos-seedrng/Config.in
```kconfig
config BR2_PACKAGE_SLOPOS_SEEDRNG
	bool "slopos-seedrng"
	depends on BR2_INIT_SYSV
	help
	  Install the standalone seedrng utility plus the early-boot init script
	  used by slopOS so persistent random seeding does not depend on BusyBox.
```

## linux-vm/configs/slopos_aarch64_virt_defconfig
```kconfig
BR2_aarch64=y
BR2_PACKAGE_HOST_LINUX_HEADERS_CUSTOM_6_18=y
BR2_GLOBAL_PATCH_DIR="board/qemu/patches"
BR2_DOWNLOAD_FORCE_CHECK_HASHES=y
BR2_INIT_SYSV=y
BR2_ROOTFS_DEVICE_CREATION_DYNAMIC_DEVTMPFS=y
# BR2_PACKAGE_BUSYBOX is not set
BR2_PACKAGE_BUSYBOX_SHOW_OTHERS=y
BR2_SYSTEM_BIN_SH_DASH=y
BR2_TARGET_GENERIC_GETTY_PORT="ttyAMA0"
BR2_SYSTEM_DHCP="eth0"
# BR2_ROOTFS_OVERLAY is not set
BR2_ROOTFS_POST_FAKEROOT_SCRIPT="../board/normal-post-fakeroot.sh"
BR2_TOOLCHAIN_BUILDROOT_CXX=y
BR2_PACKAGE_HOST_ENVIRONMENT_SETUP=y
BR2_PACKAGE_BASH=y
BR2_PACKAGE_BC=y
BR2_PACKAGE_BINUTILS=y
BR2_PACKAGE_BINUTILS_TARGET=y
BR2_PACKAGE_BZIP2=y
BR2_PACKAGE_CA_CERTIFICATES=y
BR2_PACKAGE_COREUTILS=y
BR2_PACKAGE_CPIO=y
BR2_PACKAGE_DCRON=y
BR2_PACKAGE_DEBIANUTILS=y
BR2_PACKAGE_DHCP=y
BR2_PACKAGE_DHCP_CLIENT=y
BR2_PACKAGE_DIFFUTILS=y
BR2_PACKAGE_DROPBEAR=y
BR2_PACKAGE_DROPBEAR_CLIENT=y
BR2_PACKAGE_DROPBEAR_DISABLE_REVERSEDNS=y
BR2_PACKAGE_E2FSPROGS=y
BR2_PACKAGE_FILE=y
BR2_PACKAGE_FINDUTILS=y
BR2_PACKAGE_GAWK=y
BR2_PACKAGE_GIT=y
BR2_PACKAGE_GREP=y
BR2_PACKAGE_IFUPDOWN=y
BR2_PACKAGE_IPROUTE2=y
BR2_PACKAGE_IPUTILS=y
BR2_PACKAGE_KMOD=y
BR2_PACKAGE_KMOD_TOOLS=y
BR2_PACKAGE_NET_TOOLS=y
BR2_PACKAGE_LIBTOOL=y
BR2_PACKAGE_LSOF=y
BR2_PACKAGE_M4=y
BR2_PACKAGE_MAKE=y
BR2_PACKAGE_OPENSSL=y
BR2_PACKAGE_LIBOPENSSL=y
BR2_PACKAGE_PATCH=y
BR2_PACKAGE_PERL=y
BR2_PACKAGE_PROCPS_NG=y
BR2_PACKAGE_PYTHON3=y
BR2_PACKAGE_PYTHON3_SSL=y
BR2_PACKAGE_RSYNC=y
BR2_PACKAGE_SED=y
BR2_PACKAGE_SHADOW=y
BR2_PACKAGE_START_STOP_DAEMON=y
BR2_PACKAGE_SYSKLOGD=y
BR2_PACKAGE_TAR=y
BR2_PACKAGE_TIME=y
BR2_PACKAGE_TREE=y
BR2_PACKAGE_UTIL_LINUX=y
BR2_PACKAGE_UTIL_LINUX_BINARIES=y
BR2_PACKAGE_UTIL_LINUX_AGETTY=y
BR2_PACKAGE_UTIL_LINUX_MOUNT=y
BR2_PACKAGE_UTIL_LINUX_MOUNTPOINT=y
BR2_PACKAGE_XZ=y
BR2_PACKAGE_SLOPOS_SEEDRNG=y
# BR2_PACKAGE_URANDOM_SCRIPTS is not set
BR2_LINUX_KERNEL=y
BR2_LINUX_KERNEL_CUSTOM_VERSION=y
BR2_LINUX_KERNEL_CUSTOM_VERSION_VALUE="6.18.7"
BR2_LINUX_KERNEL_USE_CUSTOM_CONFIG=y
BR2_LINUX_KERNEL_CUSTOM_CONFIG_FILE="board/qemu/aarch64-virt/linux.config"
BR2_LINUX_KERNEL_NEEDS_HOST_OPENSSL=y
BR2_TARGET_ROOTFS_EXT2=y
BR2_TARGET_ROOTFS_EXT2_4=y
BR2_TARGET_ROOTFS_EXT2_LABEL="slopos-root"
BR2_TARGET_ROOTFS_EXT2_SIZE="2048M"
BR2_TARGET_ROOTFS_CPIO=y
BR2_TARGET_ROOTFS_CPIO_GZIP=y
# BR2_TARGET_ROOTFS_TAR is not set
```

## linux-vm/configs/slopos_aarch64_virt_recovery_defconfig
```kconfig
BR2_aarch64=y
BR2_PACKAGE_HOST_LINUX_HEADERS_CUSTOM_6_18=y
BR2_GLOBAL_PATCH_DIR="board/qemu/patches"
BR2_DOWNLOAD_FORCE_CHECK_HASHES=y
BR2_INIT_SYSV=y
# BR2_PACKAGE_BUSYBOX is not set
BR2_PACKAGE_BUSYBOX_SHOW_OTHERS=y
BR2_SYSTEM_BIN_SH_DASH=y
BR2_TARGET_GENERIC_GETTY_PORT="ttyAMA0"
BR2_ROOTFS_POST_FAKEROOT_SCRIPT="../board/recovery-post-fakeroot.sh"
BR2_TOOLCHAIN_BUILDROOT_CXX=y
BR2_LINUX_KERNEL=y
BR2_LINUX_KERNEL_CUSTOM_VERSION=y
BR2_LINUX_KERNEL_CUSTOM_VERSION_VALUE="6.18.7"
BR2_LINUX_KERNEL_USE_CUSTOM_CONFIG=y
BR2_LINUX_KERNEL_CUSTOM_CONFIG_FILE="board/qemu/aarch64-virt/linux.config"
BR2_TARGET_ROOTFS_CPIO=y
BR2_TARGET_ROOTFS_CPIO_GZIP=y
# BR2_TARGET_ROOTFS_EXT2 is not set
```
